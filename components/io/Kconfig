## components/proto/Kconfig
```kconfig
menu "embpet proto"

    config EMBPET_PROTO_STRESS
        bool "Frame writer stress test (never enable in production)"
        default n
        help
            Two tasks each emit 1000 events while ESP_LOGW spams, three seconds
            after boot. Check on the host with
            tools/embpet_cli.py --check-frames SEC --reset.

    config EMBPET_CONSOLE_SOAK
        bool "Console soak generator (never enable in production)"
        default n
        help
            A task emits a "soak" event and a WARN log line every 100 ms and
            reports the longest event write, log write and loop period it has
            seen since uptime 15 s, so a host can show the firmware kept running
            while the port was closed. Host side: tools/console_test.py soak.

    config EMBPET_BOOT_TRACE
        bool "Boot stall trace (never enable in production)"
        default n
        depends on EMBPET_CONSOLE_SOAK && FREERTOS_GENERATE_RUN_TIME_STATS
        help
            Records late wake-ups of a priority-5 and a priority-24 task, late
            esp_timer callbacks, per-task CPU, and the timing of PHY
            calibration, the WPA PMK derivation, flash erase/write, TLS
            handshakes and Wi-Fi events until uptime 20 s; `trace` returns
            the records (embpet-s2j.5, tools/boot_trace.py).

    config EMBPET_CONSOLE_PROBE
        bool "Console CPU probe commands (never enable in production)"
        default n
        depends on FREERTOS_GENERATE_RUN_TIME_STATS
        help
            Adds `probe cpu` (run-time counters of the console and idle tasks,
            in us) and `probe nop` (an empty ok res), so a host can measure
            console CPU per command (tools/console_cpu.py), and `probe sleep
            <ms>` / `probe echo <text>` / `probe rxoff` to test input that
            arrives while a command blocks and the RX flow control
            (tools/console_test.py pipeline).

endmenu
```

## components/tgbot/Kconfig
```kconfig
menu "embpet tgbot"

    config EMBPET_TG_BRIDGE
        bool "Telegram bridge (tg send, poller, routing, pending table)"
        default y
        help
            Starts the tg_poll and tg_send tasks and registers the tg
            commands (README 2.1, 3.4). Only the Bot API client test build
            (tgtest.defaults) turns it off, because its own test workers
            poll the same bot and two getUpdates loops conflict (HTTP 409).

    config EMBPET_TG_TEST
        bool "Bot API client test commands (never enable in production)"
        default n
        help
            Compiles in test-only console commands (`tg t_*`): store a token,
            call getMe / deleteWebhook / getUpdates / sendMessage from two
            worker tasks that own the poll and send connections, and run a
            polling + sending soak with heap statistics. Used by
            tools/tg_test.py. With the bridge on it also adds the bridge test
            commands (owner chat, injected updates, pending entries, stack
            headroom) used by tools/bridge_test.py.

endmenu
```

## main/Kconfig.projbuild
```kconfig
menu "embpet"

    config EMBPET_PENDING_MAX
        int "Maximum pending Telegram messages"
        default 64
        range 1 256
        help
            Size of the RAM-only pending (unanswered) table, README 2.1.

    config EMBPET_EVT_RING
        int "Event ring size (events kept for replay)"
        default 32
        range 1 1024
        help
            Number of recent evt frames kept for replay, README 3.3.

    config EMBPET_PULSE_DEFAULT_MS
        int "Default output pulse length (ms)"
        default 100
        range 1 EMBPET_PULSE_MAX_MS
        help
            Pulse length used by io pulse without -d, README 2.4.

    config EMBPET_PULSE_MAX_MS
        int "Maximum output pulse length (ms)"
        default 600000
        range 1 86400000
        help
            Upper bound for io pulse -d, README 2.4.

    config EMBPET_DEBOUNCE_DEFAULT_MS
        int "Default input debounce time (ms)"
        default 20
        range 0 1000
        help
            Debounce time for inputs without a stored value, README 2.3.

    config EMBPET_TG_POLL_TIMEOUT_S
        int "Telegram getUpdates long-poll timeout (s)"
        default 50
        range 1 300
        help
            Long-poll timeout of the getUpdates request, README 2.1.

    config EMBPET_TG_SEND_TIMEOUT_MS
        int "Telegram sendMessage timeout (ms)"
        default 10000
        range 1000 120000
        help
            Timeout of the send connection to the Bot API, README 2.1.

    config EMBPET_MAX_TEXT_BYTES
        int "Maximum message text size (bytes)"
        default 4096
        range 1 8192
        help
            Longest outgoing message text, UTF-8 bytes; longer text is rejected
            with too_long, README 2.1.

    config EMBPET_CMDLINE_MAX
        int "Maximum serial CLI line length (bytes)"
        default 4400
        range 64 16384
        help
            Maximum esp_console command line, README 3.1.

    config EMBPET_WIFI_TXPOWER_QDBM
        int "Wi-Fi TX power in quarter-dBm (34 = 8.5 dBm)"
        default 34
        range 8 80
        help
            Default Wi-Fi TX power, 8 to 80 (2 to 20 dBm), README 1.3 and 3.4.

    config EMBPET_LED_GPIO
        int "Status LED GPIO"
        default 8
        range 0 21
        help
            GPIO of the status LED, README 2.2. Do not use the reserved pins
            GPIO9 (BOOT button) or GPIO18/19 (USB), README 1.2.

    config EMBPET_LED_ACTIVE_LOW
        bool "Status LED is active low"
        default y
        help
            The onboard LED is assumed active low, README 1.2 and 2.2.

endmenu
```
